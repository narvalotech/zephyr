## west.yml
```yaml
# The west manifest file for upstream Zephyr.
#
# The per-installation west configuration file, .west/config, sets the
# path to the project containing this file in the [manifest] section's
# "path" variable.
#
# You are free to create your own manifest files and put them in any
# repository you want, to create your own custom Zephyr installations.
# For example, you could create a manifest file in your own out of
# tree application directory, which would pull this zephyr repository
# in as an ordinary project.
#
# You can pass your manifest repositories to west init when creating a
# new Zephyr installation. See the west documentation for more
# information.

manifest:
  defaults:
    remote: upstream

  remotes:
    - name: upstream
      url-base: https://github.com/zephyrproject-rtos
    - name: babblesim
      url-base: https://github.com/BabbleSim

  group-filter: [-babblesim, -optional]

  #
  # Please add items below based on alphabetical order
  # zephyr-keep-sorted-start re(^\s+\- name:)
  projects:
    - name: babblesim_base
      remote: babblesim
      repo-path: base
      path: tools/bsim/components
      revision: 0cc70e78a88c1de9d8ec045a703b38134861e7e7
      groups:
        - babblesim
    - name: babblesim_ext_2G4_channel_NtNcable
      remote: babblesim
      repo-path: ext_2G4_channel_NtNcable
      path: tools/bsim/components/ext_2G4_channel_NtNcable
      revision: 20a38c997f507b0aa53817aab3d73a462fff7af1
      groups:
        - babblesim
    - name: babblesim_ext_2G4_channel_multiatt
      remote: babblesim
      repo-path: ext_2G4_channel_multiatt
      path: tools/bsim/components/ext_2G4_channel_multiatt
      revision: bde72a57384dde7a4310bcf3843469401be93074
      groups:
        - babblesim
    - name: babblesim_ext_2G4_device_WLAN_actmod
      remote: babblesim
      repo-path: ext_2G4_device_WLAN_actmod
      path: tools/bsim/components/ext_2G4_device_WLAN_actmod
      revision: 9cb6d8e72695f6b785e57443f0629a18069d6ce4
      groups:
        - babblesim
    - name: babblesim_ext_2G4_device_burst_interferer
      remote: babblesim
      repo-path: ext_2G4_device_burst_interferer
      path: tools/bsim/components/ext_2G4_device_burst_interferer
      revision: 5b5339351d6e6a2368c686c734dc8b2fc65698fc
      groups:
        - babblesim
    - name: babblesim_ext_2G4_device_playback
      remote: babblesim
      repo-path: ext_2G4_device_playback
      path: tools/bsim/components/ext_2G4_device_playback
      revision: abb48cd71ddd4e2a9022f4bf49b2712524c483e8
      groups:
        - babblesim
    - name: babblesim_ext_2G4_libPhyComv1
      remote: babblesim
      repo-path: ext_2G4_libPhyComv1
      path: tools/bsim/components/ext_2G4_libPhyComv1
      revision: 15ae0f87fa049e04cbec48a866f3bc37d903f950
      groups:
        - babblesim
    - name: babblesim_ext_2G4_modem_BLE_simple
      remote: babblesim
      repo-path: ext_2G4_modem_BLE_simple
      path: tools/bsim/components/ext_2G4_modem_BLE_simple
      revision: 4d2379de510684cd4b1c3bbbb09bce7b5a20bc1f
      groups:
        - babblesim
    - name: babblesim_ext_2G4_modem_magic
      remote: babblesim
      repo-path: ext_2G4_modem_magic
      path: tools/bsim/components/ext_2G4_modem_magic
      revision: edfcda2d3937a74be0a59d6cd47e0f50183453da
      groups:
        - babblesim
    - name: babblesim_ext_2G4_phy_v1
      remote: babblesim
      repo-path: ext_2G4_phy_v1
      path: tools/bsim/components/ext_2G4_phy_v1
      revision: 62e797b2c518e5bb6123a198382ed2b64b8c068e
      groups:
        - babblesim
    - name: babblesim_ext_libCryptov1
      remote: babblesim
      repo-path: ext_libCryptov1
      path: tools/bsim/components/ext_libCryptov1
      revision: 236309584c90be32ef12848077bd6de54e9f4deb
      groups:
        - babblesim
    - name: bsim
      repo-path: babblesim-manifest
      revision: 1f242f4ed7fc141fdfcfeca8d21c6d9e801179d7
      path: tools/bsim
      groups:
        - babblesim
    - name: cmsis
      revision: 4b96cbb174678dcd3ca86e11e1f24bc5f8726da0
      path: modules/hal/cmsis
      groups:
        - hal
    - name: edtt
      revision: b9ca3c7030518f07b7937dacf970d37a47865a76
      path: tools/edtt
      groups:
        - tools
    - name: hal_nordic
      revision: e0e48c4ec75595767a286389e2fcda72b21363b0
      path: modules/hal/nordic
      groups:
        - hal
    - name: mbedtls
      revision: 4952e1328529ee549d412b498ea71c54f30aa3b1
      path: modules/crypto/mbedtls
      groups:
        - crypto
    - name: mcuboot
      revision: 5d6471bac184c8accaeeb0efcfad8dd35225a28d
      path: bootloader/mcuboot
      groups:
        - bootloader
    - name: nrf_hw_models
      revision: fbc6e614686b69dfa56f9694350b9488cf83d3f7
      path: modules/bsim_hw_models/nrf_hw_models
    - name: picolibc
      path: modules/lib/picolibc
      revision: d492d5fa7c96918e37653f303028346bb0dd51a2
    - name: segger
      revision: 1a607e8718171cfbc1ee6b2a5ec00f619d1cc7fc
      path: modules/debug/segger
      groups:
        - debug
    - name: tinycrypt
      revision: 1012a3ebee18c15ede5efc8332ee2fc37817670f
      path: modules/crypto/tinycrypt
      groups:
        - crypto
    - name: zcbor
      revision: 9b07780aca6fb21f82a241ba386ad9b379809337
      path: modules/lib/zcbor
  # zephyr-keep-sorted-stop

  self:
    path: zephyr
    west-commands: scripts/west-commands.yml
    import: submanifests
```
